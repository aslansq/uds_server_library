/* Description: LIN Description file */
/* Version: 1.0 */
/* Project: LDF Template for vFlash */

// Global Definitions
LIN_description_file;
LIN_protocol_version = "2.1";
LIN_language_version = "2.1";
LIN_speed = 19.2 kbps; // baudrate (1.0-20.0)
// End of Global Definitions

Nodes // Nodes Definition
{
  Master:
    LINMasterNode, // master node name
    1 ms, // time base (real)
    0 ms; // jitter (real)

  Slaves:
    LINSlaveNode1,
    LINSlaveNode2,
    LINSlaveNode3,
    LINSlaveNode4,
    LINSlaveNode5,
    LINSlaveNode6,
    LINSlaveNode7,
    LINSlaveNode8,
    LINSlaveNode9,
    LINSlaveNode10,
    LINSlaveNode11,
    LINSlaveNode12,
    LINSlaveNode13,
    LINSlaveNode14,
    LINSlaveNode15,
    LINSlaveNode16,
    LINSlaveNode17,
    LINSlaveNode18,
    LINSlaveNode19,
    LINSlaveNode20,
    LINSlaveNode21,
    LINSlaveNode22,
    LINSlaveNode23,
    LINSlaveNode24,
    LINSlaveNode25,
    LINSlaveNode26,
    LINSlaveNode27,
    LINSlaveNode28,
    LINSlaveNode29,
    LINSlaveNode30,
    LINSlaveNode31,
    LINSlaveNode32,
    LINSlaveNode33,
    LINSlaveNode34,
    LINSlaveNode35,
    LINSlaveNode36,
    LINSlaveNode37,
    LINSlaveNode38,
    LINSlaveNode39,
    LINSlaveNode40,
    LINSlaveNode41,
    LINSlaveNode42,
    LINSlaveNode43,
    LINSlaveNode44,
    LINSlaveNode45,
    LINSlaveNode46,
    LINSlaveNode47,
    LINSlaveNode48,
    LINSlaveNode49,
    LINSlaveNode50,
    LINSlaveNode51,
    LINSlaveNode52,
    LINSlaveNode53,
    LINSlaveNode54,
    LINSlaveNode55,
    LINSlaveNode56,
    LINSlaveNode57,
    LINSlaveNode58,
    LINSlaveNode59,
    LINSlaveNode60,
    LINSlaveNode61,
    LINSlaveNode62,
    LINSlaveNode63,
    LINSlaveNode64,
    LINSlaveNode65,
    LINSlaveNode66,
    LINSlaveNode67,
    LINSlaveNode68,
    LINSlaveNode69,
    LINSlaveNode70,
    LINSlaveNode71,
    LINSlaveNode72,
    LINSlaveNode73,
    LINSlaveNode74,
    LINSlaveNode75,
    LINSlaveNode76,
    LINSlaveNode77,
    LINSlaveNode78,
    LINSlaveNode79,
    LINSlaveNode80,
    LINSlaveNode81,
    LINSlaveNode82,
    LINSlaveNode83,
    LINSlaveNode84,
    LINSlaveNode85,
    LINSlaveNode86,
    LINSlaveNode87,
    LINSlaveNode88,
    LINSlaveNode89,
    LINSlaveNode90,
    LINSlaveNode91,
    LINSlaveNode92,
    LINSlaveNode93,
    LINSlaveNode94,
    LINSlaveNode95,
    LINSlaveNode96,
    LINSlaveNode97,
    LINSlaveNode98,
    LINSlaveNode99,
    LINSlaveNode100,
    LINSlaveNode101,
    LINSlaveNode102,
    LINSlaveNode103,
    LINSlaveNode104,
    LINSlaveNode105,
    LINSlaveNode106,
    LINSlaveNode107,
    LINSlaveNode108,
    LINSlaveNode109,
    LINSlaveNode110,
    LINSlaveNode111,
    LINSlaveNode112,
    LINSlaveNode113,
    LINSlaveNode114,
    LINSlaveNode115,
    LINSlaveNode116,
    LINSlaveNode117,
    LINSlaveNode118,
    LINSlaveNode119,
    LINSlaveNode120,
    LINSlaveNode121,
    LINSlaveNode122,
    LINSlaveNode123,
    LINSlaveNode124,
    LINSlaveNode125,
    LINSlaveNode126; // slave node names

} // End of Nodes Definition

Signals {
    LINMasterNode_Tx_Dummy: 16,0, LINMasterNode, LINSlaveNode1;
}

Diagnostic_signals // Diagnostic Signals Definition (optional)
{
  // MasterReq Reserved Signals
  MasterReqB0: 8, 0; // signal name: signal size, signal offset;
  MasterReqB1: 8, 0;
  MasterReqB2: 8, 0;
  MasterReqB3: 8, 0;
  MasterReqB4: 8, 0;
  MasterReqB5: 8, 0;
  MasterReqB6: 8, 0;
  MasterReqB7: 8, 0;
  // End of MasterReq Reserved Signals

  // SlaveResp Reserved Signals
  SlaveRespB0: 8, 0; // signal name: signal size, signal offset;
  SlaveRespB1: 8, 0;
  SlaveRespB2: 8, 0;
  SlaveRespB3: 8, 0;
  SlaveRespB4: 8, 0;
  SlaveRespB5: 8, 0;
  SlaveRespB6: 8, 0;
  SlaveRespB7: 8, 0;
  // End of SlaveResp Reserved Signals

} // End of Diagnostic Signals Definition

Frames {
  LINMasterNode_Tx_Dummy_FRM: 0x10, LINMasterNode,3 {
    LINMasterNode_Tx_Dummy,0;
  }
}

Diagnostic_frames // Diagnostic Frame Definition (optional)
{
  MasterReq: 60 // reserved frame name and frame identifier
  {
    MasterReqB0, 0; // diagnostic signal name, signal offset
    MasterReqB1, 8;
    MasterReqB2, 16;
    MasterReqB3, 24;
    MasterReqB4, 32;
    MasterReqB5, 40;
    MasterReqB6, 48;
    MasterReqB7, 56;
  }

  SlaveResp: 61 // reserved frame name and frame identifier
  {
    SlaveRespB0, 0; // diagnostic signal name, signal offset
    SlaveRespB1, 8;
    SlaveRespB2, 16;
    SlaveRespB3, 24;
    SlaveRespB4, 32;
    SlaveRespB5, 40;
    SlaveRespB6, 48;
    SlaveRespB7, 56;
  }
} // End of Diagnostic Frame Definition

Node_attributes // Node Attributes Definition
{
  LINSlaveNode1 // node name
  {
    LIN_protocol = "2.1";
    configured_NAD = 1; // initial NAD of node (1-126)
    P2_min = 50 ms; // min. time (real) between MasterReq and SlaveResp
    ST_min = 0 ms; // min. time (real) between consecutive SlaveResps
    N_As_timeout = 1000 ms;
    N_Cr_timeout = 1000 ms;
  } // End of Node Attribut

  LINSlaveNode2 // node name
  {
    LIN_protocol = "2.1";
    configured_NAD = 2; // initial NAD of node (1-126)
    P2_min = 50 ms; // min. time (real) between MasterReq and SlaveResp
    ST_min = 0 ms; // min. time (real) between consecutive SlaveResps
    N_As_timeout = 1000 ms;
    N_Cr_timeout = 1000 ms;
  } // End of Node Attribut

  LINSlaveNode3 // node name
  {
    LIN_protocol = "2.1";
    configured_NAD = 3; // initial NAD of node (1-126)
    P2_min = 50 ms; // min. time (real) between MasterReq and SlaveResp
    ST_min = 0 ms; // min. time (real) between consecutive SlaveResps
    N_As_timeout = 1000 ms;
    N_Cr_timeout = 1000 ms;
  } // End of Node Attribut

  LINSlaveNode4 // node name
  {
    LIN_protocol = "2.1";
    configured_NAD = 4; // initial NAD of node (1-126)
    P2_min = 50 ms; // min. time (real) between MasterReq and SlaveResp
    ST_min = 0 ms; // min. time (real) between consecutive SlaveResps
    N_As_timeout = 1000 ms;
    N_Cr_timeout = 1000 ms;
  } // End of Node Attribut

  LINSlaveNode5 // node name
  {
    LIN_protocol = "2.1";
    configured_NAD = 5; // initial NAD of node (1-126)
    P2_min = 50 ms; // min. time (real) between MasterReq and SlaveResp
    ST_min = 0 ms; // min. time (real) between consecutive SlaveResps
    N_As_timeout = 1000 ms;
    N_Cr_timeout = 1000 ms;
  } // End of Node Attribut

  LINSlaveNode6 // node name
  {
    LIN_protocol = "2.1";
    configured_NAD = 6; // initial NAD of node (1-126)
    P2_min = 50 ms; // min. time (real) between MasterReq and SlaveResp
    ST_min = 0 ms; // min. time (real) between consecutive SlaveResps
    N_As_timeout = 1000 ms;
    N_Cr_timeout = 1000 ms;
  } // End of Node Attribut

  LINSlaveNode7 // node name
  {
    LIN_protocol = "2.1";
    configured_NAD = 7; // initial NAD of node (1-126)
    P2_min = 50 ms; // min. time (real) between MasterReq and SlaveResp
    ST_min = 0 ms; // min. time (real) between consecutive SlaveResps
    N_As_timeout = 1000 ms;
    N_Cr_timeout = 1000 ms;
  } // End of Node Attribut

  LINSlaveNode8 // node name
  {
    LIN_protocol = "2.1";
    configured_NAD = 8; // initial NAD of node (1-126)
    P2_min = 50 ms; // min. time (real) between MasterReq and SlaveResp
    ST_min = 0 ms; // min. time (real) between consecutive SlaveResps
    N_As_timeout = 1000 ms;
    N_Cr_timeout = 1000 ms;
  } // End of Node Attribut

  LINSlaveNode9 // node name
  {
    LIN_protocol = "2.1";
    configured_NAD = 9; // initial NAD of node (1-126)
    P2_min = 50 ms; // min. time (real) between MasterReq and SlaveResp
    ST_min = 0 ms; // min. time (real) between consecutive SlaveResps
    N_As_timeout = 1000 ms;
    N_Cr_timeout = 1000 ms;
  } // End of Node Attribut

  LINSlaveNode10 // node name
  {
    LIN_protocol = "2.1";
    configured_NAD = 10; // initial NAD of node (1-126)
    P2_min = 50 ms; // min. time (real) between MasterReq and SlaveResp
    ST_min = 0 ms; // min. time (real) between consecutive SlaveResps
    N_As_timeout = 1000 ms;
    N_Cr_timeout = 1000 ms;
  } // End of Node Attribut

  LINSlaveNode11 // node name
  {
    LIN_protocol = "2.1";
    configured_NAD = 11; // initial NAD of node (1-126)
    P2_min = 50 ms; // min. time (real) between MasterReq and SlaveResp
    ST_min = 0 ms; // min. time (real) between consecutive SlaveResps
    N_As_timeout = 1000 ms;
    N_Cr_timeout = 1000 ms;
  } // End of Node Attribut

  LINSlaveNode12 // node name
  {
    LIN_protocol = "2.1";
    configured_NAD = 12;// initial NAD of node (1-126)
    P2_min = 50 ms; // min. time (real) between MasterReq and SlaveResp
    ST_min = 0 ms; // min. time (real) between consecutive SlaveResps
    N_As_timeout = 1000 ms;
    N_Cr_timeout = 1000 ms;
  } // End of Node Attribut

  LINSlaveNode13 // node name
  {
    LIN_protocol = "2.1";
    configured_NAD = 13; // initial NAD of node (1-126)
    P2_min = 50 ms; // min. time (real) between MasterReq and SlaveResp
    ST_min = 0 ms; // min. time (real) between consecutive SlaveResps
    N_As_timeout = 1000 ms;
    N_Cr_timeout = 1000 ms;
  } // End of Node Attribut

  LINSlaveNode14 // node name
  {
    LIN_protocol = "2.1";
    configured_NAD = 14;// initial NAD of node (1-126)
    P2_min = 50 ms; // min. time (real) between MasterReq and SlaveResp
    ST_min = 0 ms; // min. time (real) between consecutive SlaveResps
    N_As_timeout = 1000 ms;
    N_Cr_timeout = 1000 ms;
  } // End of Node Attribut

  LINSlaveNode15 // node name
  {
    LIN_protocol = "2.1";
    configured_NAD = 15; // initial NAD of node (1-126)
    P2_min = 50 ms; // min. time (real) between MasterReq and SlaveResp
    ST_min = 0 ms; // min. time (real) between consecutive SlaveResps
    N_As_timeout = 1000 ms;
    N_Cr_timeout = 1000 ms;
  } // End of Node Attribut

  LINSlaveNode16 // node name
  {
    LIN_protocol = "2.1";
    configured_NAD = 16;// initial NAD of node (1-126)
    P2_min = 50 ms; // min. time (real) between MasterReq and SlaveResp
    ST_min = 0 ms; // min. time (real) between consecutive SlaveResps
    N_As_timeout = 1000 ms;
    N_Cr_timeout = 1000 ms;
  } // End of Node Attribut

  LINSlaveNode17 // node name
  {
    LIN_protocol = "2.1";
    configured_NAD = 17; // initial NAD of node (1-126)
    P2_min = 50 ms; // min. time (real) between MasterReq and SlaveResp
    ST_min = 0 ms; // min. time (real) between consecutive SlaveResps
    N_As_timeout = 1000 ms;
    N_Cr_timeout = 1000 ms;
  } // End of Node Attribut

  LINSlaveNode18 // node name
  {
    LIN_protocol = "2.1";
    configured_NAD = 18;// initial NAD of node (1-126)
    P2_min = 50 ms; // min. time (real) between MasterReq and SlaveResp
    ST_min = 0 ms; // min. time (real) between consecutive SlaveResps
    N_As_timeout = 1000 ms;
    N_Cr_timeout = 1000 ms;
  } // End of Node Attribut

  LINSlaveNode19 // node name
  {
    LIN_protocol = "2.1";
    configured_NAD = 19; // initial NAD of node (1-126)
    P2_min = 50 ms; // min. time (real) between MasterReq and SlaveResp
    ST_min = 0 ms; // min. time (real) between consecutive SlaveResps
    N_As_timeout = 1000 ms;
    N_Cr_timeout = 1000 ms;
  } // End of Node Attribut

  LINSlaveNode20 // node name
  {
    LIN_protocol = "2.1";
    configured_NAD = 20; // initial NAD of node (1-126)
    P2_min = 50 ms; // min. time (real) between MasterReq and SlaveResp
    ST_min = 0 ms; // min. time (real) between consecutive SlaveResps
    N_As_timeout = 1000 ms;
    N_Cr_timeout = 1000 ms;
  } // End of Node Attribut

  LINSlaveNode21 // node name
  {
    LIN_protocol = "2.1";
    configured_NAD = 21; // initial NAD of node (1-126)
    P2_min = 50 ms; // min. time (real) between MasterReq and SlaveResp
    ST_min = 0 ms; // min. time (real) between consecutive SlaveResps
    N_As_timeout = 1000 ms;
    N_Cr_timeout = 1000 ms;
  } // End of Node Attribut

  LINSlaveNode22 // node name
  {
    LIN_protocol = "2.1";
    configured_NAD = 22;// initial NAD of node (1-126)
    P2_min = 50 ms; // min. time (real) between MasterReq and SlaveResp
    ST_min = 0 ms; // min. time (real) between consecutive SlaveResps
    N_As_timeout = 1000 ms;
    N_Cr_timeout = 1000 ms;
  } // End of Node Attribut

  LINSlaveNode23 // node name
  {
    LIN_protocol = "2.1";
    configured_NAD = 23; // initial NAD of node (1-126)
    P2_min = 50 ms; // min. time (real) between MasterReq and SlaveResp
    ST_min = 0 ms; // min. time (real) between consecutive SlaveResps
    N_As_timeout = 1000 ms;
    N_Cr_timeout = 1000 ms;
  } // End of Node Attribut

  LINSlaveNode24 // node name
  {
    LIN_protocol = "2.1";
    configured_NAD = 24;// initial NAD of node (1-126)
    P2_min = 50 ms; // min. time (real) between MasterReq and SlaveResp
    ST_min = 0 ms; // min. time (real) between consecutive SlaveResps
    N_As_timeout = 1000 ms;
    N_Cr_timeout = 1000 ms;
  } // End of Node Attribut

  LINSlaveNode25 // node name
  {
    LIN_protocol = "2.1";
    configured_NAD = 25; // initial NAD of node (1-126)
    P2_min = 50 ms; // min. time (real) between MasterReq and SlaveResp
    ST_min = 0 ms; // min. time (real) between consecutive SlaveResps
    N_As_timeout = 1000 ms;
    N_Cr_timeout = 1000 ms;
  } // End of Node Attribut

  LINSlaveNode26 // node name
  {
    LIN_protocol = "2.1";
    configured_NAD = 26;// initial NAD of node (1-126)
    P2_min = 50 ms; // min. time (real) between MasterReq and SlaveResp
    ST_min = 0 ms; // min. time (real) between consecutive SlaveResps
    N_As_timeout = 1000 ms;
    N_Cr_timeout = 1000 ms;
  } // End of Node Attribut

  LINSlaveNode27 // node name
  {
    LIN_protocol = "2.1";
    configured_NAD = 27; // initial NAD of node (1-126)
    P2_min = 50 ms; // min. time (real) between MasterReq and SlaveResp
    ST_min = 0 ms; // min. time (real) between consecutive SlaveResps
    N_As_timeout = 1000 ms;
    N_Cr_timeout = 1000 ms;
  } // End of Node Attribut

  LINSlaveNode28 // node name
  {
    LIN_protocol = "2.1";
    configured_NAD = 28; // initial NAD of node (1-126)
    P2_min = 50 ms; // min. time (real) between MasterReq and SlaveResp
    ST_min = 0 ms; // min. time (real) between consecutive SlaveResps
    N_As_timeout = 1000 ms;
    N_Cr_timeout = 1000 ms;
  } // End of Node Attribut

  LINSlaveNode29 // node name
  {
    LIN_protocol = "2.1";
    configured_NAD = 29; // initial NAD of node (1-126)
    P2_min = 50 ms; // min. time (real) between MasterReq and SlaveResp
    ST_min = 0 ms; // min. time (real) between consecutive SlaveResps
    N_As_timeout = 1000 ms;
    N_Cr_timeout = 1000 ms;
  } // End of Node Attribut

  LINSlaveNode30 // node name
  {
    LIN_protocol = "2.1";
    configured_NAD = 30; // initial NAD of node (1-126)
    P2_min = 50 ms; // min. time (real) between MasterReq and SlaveResp
    ST_min = 0 ms; // min. time (real) between consecutive SlaveResps
    N_As_timeout = 1000 ms;
    N_Cr_timeout = 1000 ms;
  } // End of Node Attribut

  LINSlaveNode31 // node name
  {
    LIN_protocol = "2.1";
    configured_NAD = 31; // initial NAD of node (1-126)
    P2_min = 50 ms; // min. time (real) between MasterReq and SlaveResp
    ST_min = 0 ms; // min. time (real) between consecutive SlaveResps
    N_As_timeout = 1000 ms;
    N_Cr_timeout = 1000 ms;
  } // End of Node Attribut

  LINSlaveNode32 // node name
  {
    LIN_protocol = "2.1";
    configured_NAD = 32;// initial NAD of node (1-126)
    P2_min = 50 ms; // min. time (real) between MasterReq and SlaveResp
    ST_min = 0 ms; // min. time (real) between consecutive SlaveResps
    N_As_timeout = 1000 ms;
    N_Cr_timeout = 1000 ms;
  } // End of Node Attribut

  LINSlaveNode33 // node name
  {
    LIN_protocol = "2.1";
    configured_NAD = 33; // initial NAD of node (1-126)
    P2_min = 50 ms; // min. time (real) between MasterReq and SlaveResp
    ST_min = 0 ms; // min. time (real) between consecutive SlaveResps
    N_As_timeout = 1000 ms;
    N_Cr_timeout = 1000 ms;
  } // End of Node Attribut

  LINSlaveNode34 // node name
  {
    LIN_protocol = "2.1";
    configured_NAD = 34;// initial NAD of node (1-126)
    P2_min = 50 ms; // min. time (real) between MasterReq and SlaveResp
    ST_min = 0 ms; // min. time (real) between consecutive SlaveResps
    N_As_timeout = 1000 ms;
    N_Cr_timeout = 1000 ms;
  } // End of Node Attribut

  LINSlaveNode35 // node name
  {
    LIN_protocol = "2.1";
    configured_NAD = 35; // initial NAD of node (1-126)
    P2_min = 50 ms; // min. time (real) between MasterReq and SlaveResp
    ST_min = 0 ms; // min. time (real) between consecutive SlaveResps
    N_As_timeout = 1000 ms;
    N_Cr_timeout = 1000 ms;
  } // End of Node Attribut

  LINSlaveNode36 // node name
  {
    LIN_protocol = "2.1";
    configured_NAD = 36;// initial NAD of node (1-126)
    P2_min = 50 ms; // min. time (real) between MasterReq and SlaveResp
    ST_min = 0 ms; // min. time (real) between consecutive SlaveResps
    N_As_timeout = 1000 ms;
    N_Cr_timeout = 1000 ms;
  } // End of Node Attribut

  LINSlaveNode37 // node name
  {
    LIN_protocol = "2.1";
    configured_NAD = 37; // initial NAD of node (1-126)
    P2_min = 50 ms; // min. time (real) between MasterReq and SlaveResp
    ST_min = 0 ms; // min. time (real) between consecutive SlaveResps
    N_As_timeout = 1000 ms;
    N_Cr_timeout = 1000 ms;
  } // End of Node Attribut

  LINSlaveNode38 // node name
  {
    LIN_protocol = "2.1";
    configured_NAD = 38;// initial NAD of node (1-126)
    P2_min = 50 ms; // min. time (real) between MasterReq and SlaveResp
    ST_min = 0 ms; // min. time (real) between consecutive SlaveResps
    N_As_timeout = 1000 ms;
    N_Cr_timeout = 1000 ms;
  } // End of Node Attribut

  LINSlaveNode39 // node name
  {
    LIN_protocol = "2.1";
    configured_NAD = 39; // initial NAD of node (1-126)
    P2_min = 50 ms; // min. time (real) between MasterReq and SlaveResp
    ST_min = 0 ms; // min. time (real) between consecutive SlaveResps
    N_As_timeout = 1000 ms;
    N_Cr_timeout = 1000 ms;
  } // End of Node Attribut

  LINSlaveNode40 // node name
  {
    LIN_protocol = "2.1";
    configured_NAD = 40; // initial NAD of node (1-126)
    P2_min = 50 ms; // min. time (real) between MasterReq and SlaveResp
    ST_min = 0 ms; // min. time (real) between consecutive SlaveResps
    N_As_timeout = 1000 ms;
    N_Cr_timeout = 1000 ms;
  } // End of Node Attribut

  LINSlaveNode41 // node name
  {
    LIN_protocol = "2.1";
    configured_NAD = 41; // initial NAD of node (1-126)
    P2_min = 50 ms; // min. time (real) between MasterReq and SlaveResp
    ST_min = 0 ms; // min. time (real) between consecutive SlaveResps
    N_As_timeout = 1000 ms;
    N_Cr_timeout = 1000 ms;
  } // End of Node Attribut

  LINSlaveNode42 // node name
  {
    LIN_protocol = "2.1";
    configured_NAD = 42;// initial NAD of node (1-126)
    P2_min = 50 ms; // min. time (real) between MasterReq and SlaveResp
    ST_min = 0 ms; // min. time (real) between consecutive SlaveResps
    N_As_timeout = 1000 ms;
    N_Cr_timeout = 1000 ms;
  } // End of Node Attribut

  LINSlaveNode43 // node name
  {
    LIN_protocol = "2.1";
    configured_NAD = 43; // initial NAD of node (1-126)
    P2_min = 50 ms; // min. time (real) between MasterReq and SlaveResp
    ST_min = 0 ms; // min. time (real) between consecutive SlaveResps
    N_As_timeout = 1000 ms;
    N_Cr_timeout = 1000 ms;
  } // End of Node Attribut

  LINSlaveNode44 // node name
  {
    LIN_protocol = "2.1";
    configured_NAD = 44; // initial NAD of node (1-126)
    P2_min = 50 ms; // min. time (real) between MasterReq and SlaveResp
    ST_min = 0 ms; // min. time (real) between consecutive SlaveResps
    N_As_timeout = 1000 ms;
    N_Cr_timeout = 1000 ms;
  } // End of Node Attribut

  LINSlaveNode45 // node name
  {
    LIN_protocol = "2.1";
    configured_NAD = 45; // initial NAD of node (1-126)
    P2_min = 50 ms; // min. time (real) between MasterReq and SlaveResp
    ST_min = 0 ms; // min. time (real) between consecutive SlaveResps
    N_As_timeout = 1000 ms;
    N_Cr_timeout = 1000 ms;
  } // End of Node Attribut

  LINSlaveNode46 // node name
  {
    LIN_protocol = "2.1";
    configured_NAD = 46;// initial NAD of node (1-126)
    P2_min = 50 ms; // min. time (real) between MasterReq and SlaveResp
    ST_min = 0 ms; // min. time (real) between consecutive SlaveResps
    N_As_timeout = 1000 ms;
    N_Cr_timeout = 1000 ms;
  } // End of Node Attribut

  LINSlaveNode47 // node name
  {
    LIN_protocol = "2.1";
    configured_NAD = 47; // initial NAD of node (1-126)
    P2_min = 50 ms; // min. time (real) between MasterReq and SlaveResp
    ST_min = 0 ms; // min. time (real) between consecutive SlaveResps
    N_As_timeout = 1000 ms;
    N_Cr_timeout = 1000 ms;
  } // End of Node Attribut

  LINSlaveNode48 // node name
  {
    LIN_protocol = "2.1";
    configured_NAD = 48;// initial NAD of node (1-126)
    P2_min = 50 ms; // min. time (real) between MasterReq and SlaveResp
    ST_min = 0 ms; // min. time (real) between consecutive SlaveResps
    N_As_timeout = 1000 ms;
    N_Cr_timeout = 1000 ms;
  } // End of Node Attribut

  LINSlaveNode49 // node name
  {
    LIN_protocol = "2.1";
    configured_NAD = 49; // initial NAD of node (1-126)
    P2_min = 50 ms; // min. time (real) between MasterReq and SlaveResp
    ST_min = 0 ms; // min. time (real) between consecutive SlaveResps
    N_As_timeout = 1000 ms;
    N_Cr_timeout = 1000 ms;
  } // End of Node Attribut

  LINSlaveNode50 // node name
  {
    LIN_protocol = "2.1";
    configured_NAD = 50; // initial NAD of node (1-126)
    P2_min = 50 ms; // min. time (real) between MasterReq and SlaveResp
    ST_min = 0 ms; // min. time (real) between consecutive SlaveResps
    N_As_timeout = 1000 ms;
    N_Cr_timeout = 1000 ms;
  } // End of Node Attribut

  LINSlaveNode51 // node name
  {
    LIN_protocol = "2.1";
    configured_NAD = 51; // initial NAD of node (1-126)
    P2_min = 50 ms; // min. time (real) between MasterReq and SlaveResp
    ST_min = 0 ms; // min. time (real) between consecutive SlaveResps
    N_As_timeout = 1000 ms;
    N_Cr_timeout = 1000 ms;
  } // End of Node Attribut

  LINSlaveNode52 // node name
  {
    LIN_protocol = "2.1";
    configured_NAD = 52;// initial NAD of node (1-126)
    P2_min = 50 ms; // min. time (real) between MasterReq and SlaveResp
    ST_min = 0 ms; // min. time (real) between consecutive SlaveResps
    N_As_timeout = 1000 ms;
    N_Cr_timeout = 1000 ms;
  } // End of Node Attribut

  LINSlaveNode53 // node name
  {
    LIN_protocol = "2.1";
    configured_NAD = 53; // initial NAD of node (1-126)
    P2_min = 50 ms; // min. time (real) between MasterReq and SlaveResp
    ST_min = 0 ms; // min. time (real) between consecutive SlaveResps
    N_As_timeout = 1000 ms;
    N_Cr_timeout = 1000 ms;
  } // End of Node Attribut

  LINSlaveNode54 // node name
  {
    LIN_protocol = "2.1";
    configured_NAD = 54;// initial NAD of node (1-126)
    P2_min = 50 ms; // min. time (real) between MasterReq and SlaveResp
    ST_min = 0 ms; // min. time (real) between consecutive SlaveResps
    N_As_timeout = 1000 ms;
    N_Cr_timeout = 1000 ms;
  } // End of Node Attribut

  LINSlaveNode55 // node name
  {
    LIN_protocol = "2.1";
    configured_NAD = 55; // initial NAD of node (1-126)
    P2_min = 50 ms; // min. time (real) between MasterReq and SlaveResp
    ST_min = 0 ms; // min. time (real) between consecutive SlaveResps
    N_As_timeout = 1000 ms;
    N_Cr_timeout = 1000 ms;
  } // End of Node Attribut

  LINSlaveNode56 // node name
  {
    LIN_protocol = "2.1";
    configured_NAD = 56;// initial NAD of node (1-126)
    P2_min = 50 ms; // min. time (real) between MasterReq and SlaveResp
    ST_min = 0 ms; // min. time (real) between consecutive SlaveResps
    N_As_timeout = 1000 ms;
    N_Cr_timeout = 1000 ms;
  } // End of Node Attribut

  LINSlaveNode57 // node name
  {
    LIN_protocol = "2.1";
    configured_NAD = 57; // initial NAD of node (1-126)
    P2_min = 50 ms; // min. time (real) between MasterReq and SlaveResp
    ST_min = 0 ms; // min. time (real) between consecutive SlaveResps
    N_As_timeout = 1000 ms;
    N_Cr_timeout = 1000 ms;
  } // End of Node Attribut

  LINSlaveNode58 // node name
  {
    LIN_protocol = "2.1";
    configured_NAD = 58;// initial NAD of node (1-126)
    P2_min = 50 ms; // min. time (real) between MasterReq and SlaveResp
    ST_min = 0 ms; // min. time (real) between consecutive SlaveResps
    N_As_timeout = 1000 ms;
    N_Cr_timeout = 1000 ms;
  } // End of Node Attribut

  LINSlaveNode59 // node name
  {
    LIN_protocol = "2.1";
    configured_NAD = 59; // initial NAD of node (1-126)
    P2_min = 50 ms; // min. time (real) between MasterReq and SlaveResp
    ST_min = 0 ms; // min. time (real) between consecutive SlaveResps
    N_As_timeout = 1000 ms;
    N_Cr_timeout = 1000 ms;
  } // End of Node Attribut

  LINSlaveNode60 // node name
  {
    LIN_protocol = "2.1";
    configured_NAD = 60; // initial NAD of node (1-126)
    P2_min = 50 ms; // min. time (real) between MasterReq and SlaveResp
    ST_min = 0 ms; // min. time (real) between consecutive SlaveResps
    N_As_timeout = 1000 ms;
    N_Cr_timeout = 1000 ms;
  } // End of Node Attribut

  LINSlaveNode61 // node name
  {
    LIN_protocol = "2.1";
    configured_NAD = 61; // initial NAD of node (1-126)
    P2_min = 50 ms; // min. time (real) between MasterReq and SlaveResp
    ST_min = 0 ms; // min. time (real) between consecutive SlaveResps
    N_As_timeout = 1000 ms;
    N_Cr_timeout = 1000 ms;
  } // End of Node Attribut

  LINSlaveNode62 // node name
  {
    LIN_protocol = "2.1";
    configured_NAD = 62;// initial NAD of node (1-126)
    P2_min = 50 ms; // min. time (real) between MasterReq and SlaveResp
    ST_min = 0 ms; // min. time (real) between consecutive SlaveResps
    N_As_timeout = 1000 ms;
    N_Cr_timeout = 1000 ms;
  } // End of Node Attribut

  LINSlaveNode63 // node name
  {
    LIN_protocol = "2.1";
    configured_NAD = 63; // initial NAD of node (1-126)
    P2_min = 50 ms; // min. time (real) between MasterReq and SlaveResp
    ST_min = 0 ms; // min. time (real) between consecutive SlaveResps
    N_As_timeout = 1000 ms;
    N_Cr_timeout = 1000 ms;
  } // End of Node Attribut

  LINSlaveNode64 // node name
  {
    LIN_protocol = "2.1";
    configured_NAD = 64;// initial NAD of node (1-126)
    P2_min = 50 ms; // min. time (real) between MasterReq and SlaveResp
    ST_min = 0 ms; // min. time (real) between consecutive SlaveResps
    N_As_timeout = 1000 ms;
    N_Cr_timeout = 1000 ms;
  } // End of Node Attribut

  LINSlaveNode65 // node name
  {
    LIN_protocol = "2.1";
    configured_NAD = 65; // initial NAD of node (1-126)
    P2_min = 50 ms; // min. time (real) between MasterReq and SlaveResp
    ST_min = 0 ms; // min. time (real) between consecutive SlaveResps
    N_As_timeout = 1000 ms;
    N_Cr_timeout = 1000 ms;
  } // End of Node Attribut

  LINSlaveNode66 // node name
  {
    LIN_protocol = "2.1";
    configured_NAD = 66;// initial NAD of node (1-126)
    P2_min = 50 ms; // min. time (real) between MasterReq and SlaveResp
    ST_min = 0 ms; // min. time (real) between consecutive SlaveResps
    N_As_timeout = 1000 ms;
    N_Cr_timeout = 1000 ms;
  } // End of Node Attribut

  LINSlaveNode67 // node name
  {
    LIN_protocol = "2.1";
    configured_NAD = 67; // initial NAD of node (1-126)
    P2_min = 50 ms; // min. time (real) between MasterReq and SlaveResp
    ST_min = 0 ms; // min. time (real) between consecutive SlaveResps
    N_As_timeout = 1000 ms;
    N_Cr_timeout = 1000 ms;
  } // End of Node Attribut

  LINSlaveNode68 // node name
  {
    LIN_protocol = "2.1";
    configured_NAD = 68;// initial NAD of node (1-126)
    P2_min = 50 ms; // min. time (real) between MasterReq and SlaveResp
    ST_min = 0 ms; // min. time (real) between consecutive SlaveResps
    N_As_timeout = 1000 ms;
    N_Cr_timeout = 1000 ms;
  } // End of Node Attribut

  LINSlaveNode69 // node name
  {
    LIN_protocol = "2.1";
    configured_NAD = 69; // initial NAD of node (1-126)
    P2_min = 50 ms; // min. time (real) between MasterReq and SlaveResp
    ST_min = 0 ms; // min. time (real) between consecutive SlaveResps
    N_As_timeout = 1000 ms;
    N_Cr_timeout = 1000 ms;
  } // End of Node Attribut

  LINSlaveNode70 // node name
  {
    LIN_protocol = "2.1";
    configured_NAD = 70; // initial NAD of node (1-126)
    P2_min = 50 ms; // min. time (real) between MasterReq and SlaveResp
    ST_min = 0 ms; // min. time (real) between consecutive SlaveResps
    N_As_timeout = 1000 ms;
    N_Cr_timeout = 1000 ms;
  } // End of Node Attribut

  LINSlaveNode71 // node name
  {
    LIN_protocol = "2.1";
    configured_NAD = 71; // initial NAD of node (1-126)
    P2_min = 50 ms; // min. time (real) between MasterReq and SlaveResp
    ST_min = 0 ms; // min. time (real) between consecutive SlaveResps
    N_As_timeout = 1000 ms;
    N_Cr_timeout = 1000 ms;
  } // End of Node Attribut

  LINSlaveNode72 // node name
  {
    LIN_protocol = "2.1";
    configured_NAD = 72;// initial NAD of node (1-126)
    P2_min = 50 ms; // min. time (real) between MasterReq and SlaveResp
    ST_min = 0 ms; // min. time (real) between consecutive SlaveResps
    N_As_timeout = 1000 ms;
    N_Cr_timeout = 1000 ms;
  } // End of Node Attribut

  LINSlaveNode73 // node name
  {
    LIN_protocol = "2.1";
    configured_NAD = 73; // initial NAD of node (1-126)
    P2_min = 50 ms; // min. time (real) between MasterReq and SlaveResp
    ST_min = 0 ms; // min. time (real) between consecutive SlaveResps
    N_As_timeout = 1000 ms;
    N_Cr_timeout = 1000 ms;
  } // End of Node Attribut

  LINSlaveNode74 // node name
  {
    LIN_protocol = "2.1";
    configured_NAD = 74;// initial NAD of node (1-126)
    P2_min = 50 ms; // min. time (real) between MasterReq and SlaveResp
    ST_min = 0 ms; // min. time (real) between consecutive SlaveResps
    N_As_timeout = 1000 ms;
    N_Cr_timeout = 1000 ms;
  } // End of Node Attribut

  LINSlaveNode75 // node name
  {
    LIN_protocol = "2.1";
    configured_NAD = 75; // initial NAD of node (1-126)
    P2_min = 50 ms; // min. time (real) between MasterReq and SlaveResp
    ST_min = 0 ms; // min. time (real) between consecutive SlaveResps
    N_As_timeout = 1000 ms;
    N_Cr_timeout = 1000 ms;
  } // End of Node Attribut

  LINSlaveNode76 // node name
  {
    LIN_protocol = "2.1";
    configured_NAD = 76;// initial NAD of node (1-126)
    P2_min = 50 ms; // min. time (real) between MasterReq and SlaveResp
    ST_min = 0 ms; // min. time (real) between consecutive SlaveResps
    N_As_timeout = 1000 ms;
    N_Cr_timeout = 1000 ms;
  } // End of Node Attribut

  LINSlaveNode77 // node name
  {
    LIN_protocol = "2.1";
    configured_NAD = 77; // initial NAD of node (1-126)
    P2_min = 50 ms; // min. time (real) between MasterReq and SlaveResp
    ST_min = 0 ms; // min. time (real) between consecutive SlaveResps
    N_As_timeout = 1000 ms;
    N_Cr_timeout = 1000 ms;
  } // End of Node Attribut

  LINSlaveNode78 // node name
  {
    LIN_protocol = "2.1";
    configured_NAD = 78;// initial NAD of node (1-126)
    P2_min = 50 ms; // min. time (real) between MasterReq and SlaveResp
    ST_min = 0 ms; // min. time (real) between consecutive SlaveResps
    N_As_timeout = 1000 ms;
    N_Cr_timeout = 1000 ms;
  } // End of Node Attribut

  LINSlaveNode79 // node name
  {
    LIN_protocol = "2.1";
    configured_NAD = 79; // initial NAD of node (1-126)
    P2_min = 50 ms; // min. time (real) between MasterReq and SlaveResp
    ST_min = 0 ms; // min. time (real) between consecutive SlaveResps
    N_As_timeout = 1000 ms;
    N_Cr_timeout = 1000 ms;
  } // End of Node Attribut

  LINSlaveNode80 // node name
  {
    LIN_protocol = "2.1";
    configured_NAD = 80; // initial NAD of node (1-126)
    P2_min = 50 ms; // min. time (real) between MasterReq and SlaveResp
    ST_min = 0 ms; // min. time (real) between consecutive SlaveResps
    N_As_timeout = 1000 ms;
    N_Cr_timeout = 1000 ms;
  } // End of Node Attribut

  LINSlaveNode81 // node name
  {
    LIN_protocol = "2.1";
    configured_NAD = 81; // initial NAD of node (1-126)
    P2_min = 50 ms; // min. time (real) between MasterReq and SlaveResp
    ST_min = 0 ms; // min. time (real) between consecutive SlaveResps
    N_As_timeout = 1000 ms;
    N_Cr_timeout = 1000 ms;
  } // End of Node Attribut

  LINSlaveNode82 // node name
  {
    LIN_protocol = "2.1";
    configured_NAD = 82;// initial NAD of node (1-126)
    P2_min = 50 ms; // min. time (real) between MasterReq and SlaveResp
    ST_min = 0 ms; // min. time (real) between consecutive SlaveResps
    N_As_timeout = 1000 ms;
    N_Cr_timeout = 1000 ms;
  } // End of Node Attribut

  LINSlaveNode83 // node name
  {
    LIN_protocol = "2.1";
    configured_NAD = 83; // initial NAD of node (1-126)
    P2_min = 50 ms; // min. time (real) between MasterReq and SlaveResp
    ST_min = 0 ms; // min. time (real) between consecutive SlaveResps
    N_As_timeout = 1000 ms;
    N_Cr_timeout = 1000 ms;
  } // End of Node Attribut

  LINSlaveNode84 // node name
  {
    LIN_protocol = "2.1";
    configured_NAD = 84;// initial NAD of node (1-126)
    P2_min = 50 ms; // min. time (real) between MasterReq and SlaveResp
    ST_min = 0 ms; // min. time (real) between consecutive SlaveResps
    N_As_timeout = 1000 ms;
    N_Cr_timeout = 1000 ms;
  } // End of Node Attribut

  LINSlaveNode85 // node name
  {
    LIN_protocol = "2.1";
    configured_NAD = 85; // initial NAD of node (1-126)
    P2_min = 50 ms; // min. time (real) between MasterReq and SlaveResp
    ST_min = 0 ms; // min. time (real) between consecutive SlaveResps
    N_As_timeout = 1000 ms;
    N_Cr_timeout = 1000 ms;
  } // End of Node Attribut

  LINSlaveNode86 // node name
  {
    LIN_protocol = "2.1";
    configured_NAD = 86;// initial NAD of node (1-126)
    P2_min = 50 ms; // min. time (real) between MasterReq and SlaveResp
    ST_min = 0 ms; // min. time (real) between consecutive SlaveResps
    N_As_timeout = 1000 ms;
    N_Cr_timeout = 1000 ms;
  } // End of Node Attribut

  LINSlaveNode87 // node name
  {
    LIN_protocol = "2.1";
    configured_NAD = 87; // initial NAD of node (1-126)
    P2_min = 50 ms; // min. time (real) between MasterReq and SlaveResp
    ST_min = 0 ms; // min. time (real) between consecutive SlaveResps
    N_As_timeout = 1000 ms;
    N_Cr_timeout = 1000 ms;
  } // End of Node Attribut

  LINSlaveNode88 // node name
  {
    LIN_protocol = "2.1";
    configured_NAD = 88;// initial NAD of node (1-126)
    P2_min = 50 ms; // min. time (real) between MasterReq and SlaveResp
    ST_min = 0 ms; // min. time (real) between consecutive SlaveResps
    N_As_timeout = 1000 ms;
    N_Cr_timeout = 1000 ms;
  } // End of Node Attribut

  LINSlaveNode89 // node name
  {
    LIN_protocol = "2.1";
    configured_NAD = 89; // initial NAD of node (1-126)
    P2_min = 50 ms; // min. time (real) between MasterReq and SlaveResp
    ST_min = 0 ms; // min. time (real) between consecutive SlaveResps
    N_As_timeout = 1000 ms;
    N_Cr_timeout = 1000 ms;
  } // End of Node Attribut

  LINSlaveNode90 // node name
  {
    LIN_protocol = "2.1";
    configured_NAD = 90; // initial NAD of node (1-126)
    P2_min = 50 ms; // min. time (real) between MasterReq and SlaveResp
    ST_min = 0 ms; // min. time (real) between consecutive SlaveResps
    N_As_timeout = 1000 ms;
    N_Cr_timeout = 1000 ms;
  } // End of Node Attribut

  LINSlaveNode91 // node name
  {
    LIN_protocol = "2.1";
    configured_NAD = 91; // initial NAD of node (1-126)
    P2_min = 50 ms; // min. time (real) between MasterReq and SlaveResp
    ST_min = 0 ms; // min. time (real) between consecutive SlaveResps
    N_As_timeout = 1000 ms;
    N_Cr_timeout = 1000 ms;
  } // End of Node Attribut

  LINSlaveNode92 // node name
  {
    LIN_protocol = "2.1";
    configured_NAD = 92;// initial NAD of node (1-126)
    P2_min = 50 ms; // min. time (real) between MasterReq and SlaveResp
    ST_min = 0 ms; // min. time (real) between consecutive SlaveResps
    N_As_timeout = 1000 ms;
    N_Cr_timeout = 1000 ms;
  } // End of Node Attribut

  LINSlaveNode93 // node name
  {
    LIN_protocol = "2.1";
    configured_NAD = 93; // initial NAD of node (1-126)
    P2_min = 50 ms; // min. time (real) between MasterReq and SlaveResp
    ST_min = 0 ms; // min. time (real) between consecutive SlaveResps
    N_As_timeout = 1000 ms;
    N_Cr_timeout = 1000 ms;
  } // End of Node Attribut

  LINSlaveNode94 // node name
  {
    LIN_protocol = "2.1";
    configured_NAD = 94;// initial NAD of node (1-126)
    P2_min = 50 ms; // min. time (real) between MasterReq and SlaveResp
    ST_min = 0 ms; // min. time (real) between consecutive SlaveResps
    N_As_timeout = 1000 ms;
    N_Cr_timeout = 1000 ms;
  } // End of Node Attribut

  LINSlaveNode95 // node name
  {
    LIN_protocol = "2.1";
    configured_NAD = 95; // initial NAD of node (1-126)
    P2_min = 50 ms; // min. time (real) between MasterReq and SlaveResp
    ST_min = 0 ms; // min. time (real) between consecutive SlaveResps
    N_As_timeout = 1000 ms;
    N_Cr_timeout = 1000 ms;
  } // End of Node Attribut

  LINSlaveNode96 // node name
  {
    LIN_protocol = "2.1";
    configured_NAD = 96;// initial NAD of node (1-126)
    P2_min = 50 ms; // min. time (real) between MasterReq and SlaveResp
    ST_min = 0 ms; // min. time (real) between consecutive SlaveResps
    N_As_timeout = 1000 ms;
    N_Cr_timeout = 1000 ms;
  } // End of Node Attribut

  LINSlaveNode97 // node name
  {
    LIN_protocol = "2.1";
    configured_NAD = 97; // initial NAD of node (1-126)
    P2_min = 50 ms; // min. time (real) between MasterReq and SlaveResp
    ST_min = 0 ms; // min. time (real) between consecutive SlaveResps
    N_As_timeout = 1000 ms;
    N_Cr_timeout = 1000 ms;
  } // End of Node Attribut

  LINSlaveNode98 // node name
  {
    LIN_protocol = "2.1";
    configured_NAD = 98;// initial NAD of node (1-126)
    P2_min = 50 ms; // min. time (real) between MasterReq and SlaveResp
    ST_min = 0 ms; // min. time (real) between consecutive SlaveResps
    N_As_timeout = 1000 ms;
    N_Cr_timeout = 1000 ms;
  } // End of Node Attribut

  LINSlaveNode99 // node name
  {
    LIN_protocol = "2.1";
    configured_NAD = 99; // initial NAD of node (1-126)
    P2_min = 50 ms; // min. time (real) between MasterReq and SlaveResp
    ST_min = 0 ms; // min. time (real) between consecutive SlaveResps
    N_As_timeout = 1000 ms;
    N_Cr_timeout = 1000 ms;
  } // End of Node Attribut

  LINSlaveNode100 // node name
  {
    LIN_protocol = "2.1";
    configured_NAD = 100;// initial NAD of node (1-126)
    P2_min = 50 ms; // min. time (real) between MasterReq and SlaveResp
    ST_min = 0 ms; // min. time (real) between consecutive SlaveResps
    N_As_timeout = 1000 ms;
    N_Cr_timeout = 1000 ms;
  } // End of Node Attribut

  LINSlaveNode101 // node name
  {
    LIN_protocol = "2.1";
    configured_NAD = 101;// initial NAD of node (1-126)
    P2_min = 50 ms; // min. time (real) between MasterReq and SlaveResp
    ST_min = 0 ms; // min. time (real) between consecutive SlaveResps
    N_As_timeout = 1000 ms;
    N_Cr_timeout = 1000 ms;
  } // End of Node Attribut

  LINSlaveNode102 // node name
  {
    LIN_protocol = "2.1";
    configured_NAD = 102; // initial NAD of node (1-126)
    P2_min = 50 ms; // min. time (real) between MasterReq and SlaveResp
    ST_min = 0 ms; // min. time (real) between consecutive SlaveResps
    N_As_timeout = 1000 ms;
    N_Cr_timeout = 1000 ms;
  } // End of Node Attribut

  LINSlaveNode103 // node name
  {
    LIN_protocol = "2.1";
    configured_NAD = 103; // initial NAD of node (1-126)
    P2_min = 50 ms; // min. time (real) between MasterReq and SlaveResp
    ST_min = 0 ms; // min. time (real) between consecutive SlaveResps
    N_As_timeout = 1000 ms;
    N_Cr_timeout = 1000 ms;
  } // End of Node Attribut

  LINSlaveNode104 // node name
  {
    LIN_protocol = "2.1";
    configured_NAD = 104; // initial NAD of node (1-126)
    P2_min = 50 ms; // min. time (real) between MasterReq and SlaveResp
    ST_min = 0 ms; // min. time (real) between consecutive SlaveResps
    N_As_timeout = 1000 ms;
    N_Cr_timeout = 1000 ms;
  } // End of Node Attribut

  LINSlaveNode105 // node name
  {
    LIN_protocol = "2.1";
    configured_NAD = 105; // initial NAD of node (1-126)
    P2_min = 50 ms; // min. time (real) between MasterReq and SlaveResp
    ST_min = 0 ms; // min. time (real) between consecutive SlaveResps
    N_As_timeout = 1000 ms;
    N_Cr_timeout = 1000 ms;
  } // End of Node Attribut

  LINSlaveNode106 // node name
  {
    LIN_protocol = "2.1";
    configured_NAD = 106; // initial NAD of node (1-126)
    P2_min = 50 ms; // min. time (real) between MasterReq and SlaveResp
    ST_min = 0 ms; // min. time (real) between consecutive SlaveResps
    N_As_timeout = 1000 ms;
    N_Cr_timeout = 1000 ms;
  } // End of Node Attribut

  LINSlaveNode107 // node name
  {
    LIN_protocol = "2.1";
    configured_NAD = 107; // initial NAD of node (1-126)
    P2_min = 50 ms; // min. time (real) between MasterReq and SlaveResp
    ST_min = 0 ms; // min. time (real) between consecutive SlaveResps
    N_As_timeout = 1000 ms;
    N_Cr_timeout = 1000 ms;
  } // End of Node Attribut

  LINSlaveNode108 // node name
  {
    LIN_protocol = "2.1";
    configured_NAD = 108; // initial NAD of node (1-126)
    P2_min = 50 ms; // min. time (real) between MasterReq and SlaveResp
    ST_min = 0 ms; // min. time (real) between consecutive SlaveResps
    N_As_timeout = 1000 ms;
    N_Cr_timeout = 1000 ms;
  } // End of Node Attribut

  LINSlaveNode109 // node name
  {
    LIN_protocol = "2.1";
    configured_NAD = 109; // initial NAD of node (1-126)
    P2_min = 50 ms; // min. time (real) between MasterReq and SlaveResp
    ST_min = 0 ms; // min. time (real) between consecutive SlaveResps
    N_As_timeout = 1000 ms;
    N_Cr_timeout = 1000 ms;
  } // End of Node Attribut

  LINSlaveNode110 // node name
  {
    LIN_protocol = "2.1";
    configured_NAD = 110;// initial NAD of node (1-126)
    P2_min = 50 ms; // min. time (real) between MasterReq and SlaveResp
    ST_min = 0 ms; // min. time (real) between consecutive SlaveResps
    N_As_timeout = 1000 ms;
    N_Cr_timeout = 1000 ms;
  } // End of Node Attribut

  LINSlaveNode111 // node name
  {
    LIN_protocol = "2.1";
    configured_NAD = 111;// initial NAD of node (1-126)
    P2_min = 50 ms; // min. time (real) between MasterReq and SlaveResp
    ST_min = 0 ms; // min. time (real) between consecutive SlaveResps
    N_As_timeout = 1000 ms;
    N_Cr_timeout = 1000 ms;
  } // End of Node Attribut

  LINSlaveNode112 // node name
  {
    LIN_protocol = "2.1";
    configured_NAD = 112; // initial NAD of node (1-126)
    P2_min = 50 ms; // min. time (real) between MasterReq and SlaveResp
    ST_min = 0 ms; // min. time (real) between consecutive SlaveResps
    N_As_timeout = 1000 ms;
    N_Cr_timeout = 1000 ms;
  } // End of Node Attribut

  LINSlaveNode113 // node name
  {
    LIN_protocol = "2.1";
    configured_NAD = 113; // initial NAD of node (1-126)
    P2_min = 50 ms; // min. time (real) between MasterReq and SlaveResp
    ST_min = 0 ms; // min. time (real) between consecutive SlaveResps
    N_As_timeout = 1000 ms;
    N_Cr_timeout = 1000 ms;
  } // End of Node Attribut

  LINSlaveNode114 // node name
  {
    LIN_protocol = "2.1";
    configured_NAD = 114; // initial NAD of node (1-126)
    P2_min = 50 ms; // min. time (real) between MasterReq and SlaveResp
    ST_min = 0 ms; // min. time (real) between consecutive SlaveResps
    N_As_timeout = 1000 ms;
    N_Cr_timeout = 1000 ms;
  } // End of Node Attribut

  LINSlaveNode115 // node name
  {
    LIN_protocol = "2.1";
    configured_NAD = 115; // initial NAD of node (1-126)
    P2_min = 50 ms; // min. time (real) between MasterReq and SlaveResp
    ST_min = 0 ms; // min. time (real) between consecutive SlaveResps
    N_As_timeout = 1000 ms;
    N_Cr_timeout = 1000 ms;
  } // End of Node Attribut

  LINSlaveNode116 // node name
  {
    LIN_protocol = "2.1";
    configured_NAD = 116; // initial NAD of node (1-126)
    P2_min = 50 ms; // min. time (real) between MasterReq and SlaveResp
    ST_min = 0 ms; // min. time (real) between consecutive SlaveResps
    N_As_timeout = 1000 ms;
    N_Cr_timeout = 1000 ms;
  } // End of Node Attribut

  LINSlaveNode117 // node name
  {
    LIN_protocol = "2.1";
    configured_NAD = 117; // initial NAD of node (1-126)
    P2_min = 50 ms; // min. time (real) between MasterReq and SlaveResp
    ST_min = 0 ms; // min. time (real) between consecutive SlaveResps
    N_As_timeout = 1000 ms;
    N_Cr_timeout = 1000 ms;
  } // End of Node Attribut

  LINSlaveNode118 // node name
  {
    LIN_protocol = "2.1";
    configured_NAD = 118; // initial NAD of node (1-126)
    P2_min = 50 ms; // min. time (real) between MasterReq and SlaveResp
    ST_min = 0 ms; // min. time (real) between consecutive SlaveResps
    N_As_timeout = 1000 ms;
    N_Cr_timeout = 1000 ms;
  } // End of Node Attribut

  LINSlaveNode119 // node name
  {
    LIN_protocol = "2.1";
    configured_NAD = 119; // initial NAD of node (1-126)
    P2_min = 50 ms; // min. time (real) between MasterReq and SlaveResp
    ST_min = 0 ms; // min. time (real) between consecutive SlaveResps
    N_As_timeout = 1000 ms;
    N_Cr_timeout = 1000 ms;
  } // End of Node Attribut

  LINSlaveNode120 // node name
  {
    LIN_protocol = "2.1";
    configured_NAD = 120; // initial NAD of node (1-126)
    P2_min = 50 ms; // min. time (real) between MasterReq and SlaveResp
    ST_min = 0 ms; // min. time (real) between consecutive SlaveResps
    N_As_timeout = 1000 ms;
    N_Cr_timeout = 1000 ms;
  } // End of Node Attribut

  LINSlaveNode121 // node name
  {
    LIN_protocol = "2.1";
    configured_NAD = 121; // initial NAD of node (1-126)
    P2_min = 50 ms; // min. time (real) between MasterReq and SlaveResp
    ST_min = 0 ms; // min. time (real) between consecutive SlaveResps
    N_As_timeout = 1000 ms;
    N_Cr_timeout = 1000 ms;
  } // End of Node Attribut

  LINSlaveNode122 // node name
  {
    LIN_protocol = "2.1";
    configured_NAD = 122; // initial NAD of node (1-126)
    P2_min = 50 ms; // min. time (real) between MasterReq and SlaveResp
    ST_min = 0 ms; // min. time (real) between consecutive SlaveResps
    N_As_timeout = 1000 ms;
    N_Cr_timeout = 1000 ms;
  } // End of Node Attribut

  LINSlaveNode123 // node name
  {
    LIN_protocol = "2.1";
    configured_NAD = 123; // initial NAD of node (1-126)
    P2_min = 50 ms; // min. time (real) between MasterReq and SlaveResp
    ST_min = 0 ms; // min. time (real) between consecutive SlaveResps
    N_As_timeout = 1000 ms;
    N_Cr_timeout = 1000 ms;
  } // End of Node Attribut

  LINSlaveNode124 // node name
  {
    LIN_protocol = "2.1";
    configured_NAD = 124; // initial NAD of node (1-126)
    P2_min = 50 ms; // min. time (real) between MasterReq and SlaveResp
    ST_min = 0 ms; // min. time (real) between consecutive SlaveResps
    N_As_timeout = 1000 ms;
    N_Cr_timeout = 1000 ms;
  } // End of Node Attribut

  LINSlaveNode125 // node name
  {
    LIN_protocol = "2.1";
    configured_NAD = 125; // initial NAD of node (1-126)
    P2_min = 50 ms; // min. time (real) between MasterReq and SlaveResp
    ST_min = 0 ms; // min. time (real) between consecutive SlaveResps
    N_As_timeout = 1000 ms;
    N_Cr_timeout = 1000 ms;
  } // End of Node Attribut

  LINSlaveNode126 // node name
  {
    LIN_protocol = "2.1";
    configured_NAD = 126; // initial NAD of node (1-126)
    P2_min = 50 ms; // min. time (real) between MasterReq and SlaveResp
    ST_min = 0 ms; // min. time (real) between consecutive SlaveResps
    N_As_timeout = 1000 ms;
    N_Cr_timeout = 1000 ms;
  } // End of Node Attribut

} // End of Node Attributes Definition

Schedule_tables {
 MasterReq_Table {
    MasterReq delay 10 ms ;
  }
 SlaveResp_Table {
    SlaveResp delay 10 ms ;
  }
}
